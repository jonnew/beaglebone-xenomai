## linux-3.2.21/kernel/ipipe/Kconfig
```kconfig
config IPIPE
	bool "Interrupt pipeline"
	default y
	---help---
	  Activate this option if you want the interrupt pipeline to be
	  compiled in.

config IPIPE_CORE
	def_bool y

config IPIPE_LEGACY
	bool "I-pipe legacy interface"
	depends on IPIPE
	default n
	---help---
	  Activate this option if you want to control the interrupt
	  pipeline via the legacy interface.

config IPIPE_HAVE_HOSTRT
       bool

config IPIPE_HAVE_PIC_MUTE
       bool

config HAVE_IPIPE_HOSTRT
       depends on IPIPE_LEGACY
       bool

config IPIPE_DELAYED_ATOMICSW
       def_bool y if IPIPE_LEGACY
```
